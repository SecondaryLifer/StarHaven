/* GENERATED by port/3ds/tools/gen_link_syms.py -- do not edit */

PROVIDE(shim_guRotateF = guRotateF);
PROVIDE(shim_guTranslateF = guTranslateF);
PROVIDE(shim_guTranslate = guTranslate);
PROVIDE(shim_guScaleF = guScaleF);
PROVIDE(shim_guMtxCatF = guMtxCatF);
PROVIDE(shim_guMtxF2L = guMtxF2L);
PROVIDE(shim_guMtxL2F = guMtxL2F);
PROVIDE(shim_queue_render_task = queue_render_task);
PROVIDE(shim_create_effect_instance = create_effect_instance);
PROVIDE(shim_remove_effect = remove_effect);
PROVIDE(shim_general_heap_malloc = general_heap_malloc);
PROVIDE(shim_mem_clear = mem_clear);
PROVIDE(shim_rand_int = rand_int);
PROVIDE(shim_clamp_angle = clamp_angle);
PROVIDE(shim_sin_deg = sin_deg);
PROVIDE(shim_cos_deg = cos_deg);
PROVIDE(shim_atan2 = pm_atan2);
PROVIDE(shim_npc_raycast_down_sides = npc_raycast_down_sides);
PROVIDE(shim_load_effect = load_effect);
PROVIDE(shim_sqrtf = sqrtf);
PROVIDE(shim_mdl_draw_hidden_panel_surface = mdl_draw_hidden_panel_surface);
PROVIDE(shim_is_point_visible = is_point_visible);
PROVIDE(shim_guPerspectiveF = guPerspectiveF);
PROVIDE(shim_guMtxIdentF = guMtxIdentF);
PROVIDE(shim_transform_point = transform_point);
PROVIDE(shim_guLookAtHiliteF = guLookAtHiliteF);
PROVIDE(shim_set_screen_overlay_params_back = set_screen_overlay_params_back);
PROVIDE(shim_set_screen_overlay_center = set_screen_overlay_center);
PROVIDE(shim_set_screen_overlay_center_worldpos = set_screen_overlay_center_worldpos);
PROVIDE(shim_mdl_get_next_texture_address = mdl_get_next_texture_address);
PROVIDE(shim_guPositionF = guPositionF);
PROVIDE(shim_guOrthoF = guOrthoF);
PROVIDE(shim_guFrustumF = guFrustumF);
PROVIDE(shim_draw_prev_frame_buffer_at_screen_pos = draw_prev_frame_buffer_at_screen_pos);
PROVIDE(shim_draw_box = draw_box);
PROVIDE(shim_draw_msg = draw_msg);
PROVIDE(shim_get_msg_width = get_msg_width);
PROVIDE(shim_mdl_get_shroud_tint_params = mdl_get_shroud_tint_params);
PROVIDE(shim_sfx_play_sound_at_position = sfx_play_sound_at_position);

PROVIDE(dgb_01_smash_bridges_ROM_END = pm3ds_null_segment);
PROVIDE(dgb_01_smash_bridges_ROM_START = pm3ds_null_segment);
PROVIDE(dgb_01_smash_bridges_VRAM = pm3ds_null_segment);
PROVIDE(entity_default_ROM_END = pm3ds_null_segment);
PROVIDE(entity_default_ROM_START = pm3ds_null_segment);
PROVIDE(entity_default_VRAM = pm3ds_null_segment);
PROVIDE(entity_jan_iwa_ROM_END = pm3ds_null_segment);
PROVIDE(entity_jan_iwa_ROM_START = pm3ds_null_segment);
PROVIDE(entity_jan_iwa_VRAM = pm3ds_null_segment);
PROVIDE(entity_model_ArrowSign_ROM_END = pm3ds_null_segment);
PROVIDE(entity_model_ArrowSign_ROM_START = pm3ds_null_segment);
PROVIDE(entity_model_BellbellPlant_anim_ROM_END = pm3ds_null_segment);
PROVIDE(entity_model_BellbellPlant_anim_ROM_START = pm3ds_null_segment);
PROVIDE(entity_model_BellbellPlant_gfx_ROM_END = pm3ds_null_segment);
PROVIDE(entity_model_BellbellPlant_gfx_ROM_START = pm3ds_null_segment);
PROVIDE(entity_model_BlueSwitch_ROM_END = pm3ds_null_segment);
PROVIDE(entity_model_BlueSwitch_ROM_START = pm3ds_null_segment);
PROVIDE(entity_model_BlueWarpPipe_ROM_END = pm3ds_null_segment);
PROVIDE(entity_model_BlueWarpPipe_ROM_START = pm3ds_null_segment);
PROVIDE(entity_model_BoardedFloor_ROM_END = pm3ds_null_segment);
PROVIDE(entity_model_BoardedFloor_ROM_START = pm3ds_null_segment);
PROVIDE(entity_model_BombableRock_ROM_END = pm3ds_null_segment);
PROVIDE(entity_model_BombableRock_ROM_START = pm3ds_null_segment);
PROVIDE(entity_model_BrickBlock_ROM_END = pm3ds_null_segment);
PROVIDE(entity_model_BrickBlock_ROM_START = pm3ds_null_segment);
PROVIDE(entity_model_Chest_ROM_END = pm3ds_null_segment);
PROVIDE(entity_model_Chest_ROM_START = pm3ds_null_segment);
PROVIDE(entity_model_CymbalPlant_anim_ROM_END = pm3ds_null_segment);
PROVIDE(entity_model_CymbalPlant_anim_ROM_START = pm3ds_null_segment);
PROVIDE(entity_model_CymbalPlant_gfx_ROM_END = pm3ds_null_segment);
PROVIDE(entity_model_CymbalPlant_gfx_ROM_START = pm3ds_null_segment);
PROVIDE(entity_model_GreenStompSwitch_ROM_END = pm3ds_null_segment);
PROVIDE(entity_model_GreenStompSwitch_ROM_START = pm3ds_null_segment);
PROVIDE(entity_model_Hammer1Block_ROM_END = pm3ds_null_segment);
PROVIDE(entity_model_Hammer1Block_ROM_START = pm3ds_null_segment);
PROVIDE(entity_model_Hammer2Block_ROM_END = pm3ds_null_segment);
PROVIDE(entity_model_Hammer2Block_ROM_START = pm3ds_null_segment);
PROVIDE(entity_model_Hammer3Block_ROM_END = pm3ds_null_segment);
PROVIDE(entity_model_Hammer3Block_ROM_START = pm3ds_null_segment);
PROVIDE(entity_model_HeartBlockContent_ROM_END = pm3ds_null_segment);
PROVIDE(entity_model_HeartBlockContent_ROM_START = pm3ds_null_segment);
PROVIDE(entity_model_HeartBlock_ROM_END = pm3ds_null_segment);
PROVIDE(entity_model_HeartBlock_ROM_START = pm3ds_null_segment);
PROVIDE(entity_model_HiddenPanel_ROM_END = pm3ds_null_segment);
PROVIDE(entity_model_HiddenPanel_ROM_START = pm3ds_null_segment);
PROVIDE(entity_model_HitFloatingYellowBlock_anim_ROM_END = pm3ds_null_segment);
PROVIDE(entity_model_HitFloatingYellowBlock_anim_ROM_START = pm3ds_null_segment);
PROVIDE(entity_model_HitFloatingYellowBlock_gfx_ROM_END = pm3ds_null_segment);
PROVIDE(entity_model_HitFloatingYellowBlock_gfx_ROM_START = pm3ds_null_segment);
PROVIDE(entity_model_HitRedBlock_anim_ROM_END = pm3ds_null_segment);
PROVIDE(entity_model_HitRedBlock_anim_ROM_START = pm3ds_null_segment);
PROVIDE(entity_model_HitRedBlock_gfx_ROM_END = pm3ds_null_segment);
PROVIDE(entity_model_HitRedBlock_gfx_ROM_START = pm3ds_null_segment);
PROVIDE(entity_model_HitYellowBlock_anim_ROM_END = pm3ds_null_segment);
PROVIDE(entity_model_HitYellowBlock_anim_ROM_START = pm3ds_null_segment);
PROVIDE(entity_model_HitYellowBlock_gfx_ROM_END = pm3ds_null_segment);
PROVIDE(entity_model_HitYellowBlock_gfx_ROM_START = pm3ds_null_segment);
PROVIDE(entity_model_InertRedBlock_ROM_END = pm3ds_null_segment);
PROVIDE(entity_model_InertRedBlock_ROM_START = pm3ds_null_segment);
PROVIDE(entity_model_InertYellowBlock_ROM_END = pm3ds_null_segment);
PROVIDE(entity_model_InertYellowBlock_ROM_START = pm3ds_null_segment);
PROVIDE(entity_model_MunchlesiaBeginChew_anim_ROM_END = pm3ds_null_segment);
PROVIDE(entity_model_MunchlesiaBeginChew_anim_ROM_START = pm3ds_null_segment);
PROVIDE(entity_model_MunchlesiaBeginChew_gfx_ROM_END = pm3ds_null_segment);
PROVIDE(entity_model_MunchlesiaBeginChew_gfx_ROM_START = pm3ds_null_segment);
PROVIDE(entity_model_MunchlesiaChewing_anim_ROM_END = pm3ds_null_segment);
PROVIDE(entity_model_MunchlesiaChewing_anim_ROM_START = pm3ds_null_segment);
PROVIDE(entity_model_MunchlesiaChewing_gfx_ROM_END = pm3ds_null_segment);
PROVIDE(entity_model_MunchlesiaChewing_gfx_ROM_START = pm3ds_null_segment);
PROVIDE(entity_model_MunchlesiaEnvelop_anim_ROM_END = pm3ds_null_segment);
PROVIDE(entity_model_MunchlesiaEnvelop_anim_ROM_START = pm3ds_null_segment);
PROVIDE(entity_model_MunchlesiaEnvelop_gfx_ROM_END = pm3ds_null_segment);
PROVIDE(entity_model_MunchlesiaEnvelop_gfx_ROM_START = pm3ds_null_segment);
PROVIDE(entity_model_MunchlesiaGrab_anim_ROM_END = pm3ds_null_segment);
PROVIDE(entity_model_MunchlesiaGrab_anim_ROM_START = pm3ds_null_segment);
PROVIDE(entity_model_MunchlesiaGrab_gfx_ROM_END = pm3ds_null_segment);
PROVIDE(entity_model_MunchlesiaGrab_gfx_ROM_START = pm3ds_null_segment);
PROVIDE(entity_model_MunchlesiaReset1_anim_ROM_END = pm3ds_null_segment);
PROVIDE(entity_model_MunchlesiaReset1_anim_ROM_START = pm3ds_null_segment);
PROVIDE(entity_model_MunchlesiaReset1_gfx_ROM_END = pm3ds_null_segment);
PROVIDE(entity_model_MunchlesiaReset1_gfx_ROM_START = pm3ds_null_segment);
PROVIDE(entity_model_MunchlesiaReset_anim_ROM_END = pm3ds_null_segment);
PROVIDE(entity_model_MunchlesiaReset_anim_ROM_START = pm3ds_null_segment);
PROVIDE(entity_model_MunchlesiaReset_gfx_ROM_END = pm3ds_null_segment);
PROVIDE(entity_model_MunchlesiaReset_gfx_ROM_START = pm3ds_null_segment);
PROVIDE(entity_model_MunchlesiaSpitOut_anim_ROM_END = pm3ds_null_segment);
PROVIDE(entity_model_MunchlesiaSpitOut_anim_ROM_START = pm3ds_null_segment);
PROVIDE(entity_model_MunchlesiaSpitOut_gfx_ROM_END = pm3ds_null_segment);
PROVIDE(entity_model_MunchlesiaSpitOut_gfx_ROM_START = pm3ds_null_segment);
PROVIDE(entity_model_PadlockBlueFace_ROM_END = pm3ds_null_segment);
PROVIDE(entity_model_PadlockBlueFace_ROM_START = pm3ds_null_segment);
PROVIDE(entity_model_PadlockRedFace_ROM_END = pm3ds_null_segment);
PROVIDE(entity_model_PadlockRedFace_ROM_START = pm3ds_null_segment);
PROVIDE(entity_model_PadlockRedFrame_ROM_END = pm3ds_null_segment);
PROVIDE(entity_model_PadlockRedFrame_ROM_START = pm3ds_null_segment);
PROVIDE(entity_model_Padlock_ROM_END = pm3ds_null_segment);
PROVIDE(entity_model_Padlock_ROM_START = pm3ds_null_segment);
PROVIDE(entity_model_PinkFlower_anim_ROM_END = pm3ds_null_segment);
PROVIDE(entity_model_PinkFlower_anim_ROM_START = pm3ds_null_segment);
PROVIDE(entity_model_PinkFlower_gfx_ROM_END = pm3ds_null_segment);
PROVIDE(entity_model_PinkFlower_gfx_ROM_START = pm3ds_null_segment);
PROVIDE(entity_model_PowBlock_ROM_END = pm3ds_null_segment);
PROVIDE(entity_model_PowBlock_ROM_START = pm3ds_null_segment);
PROVIDE(entity_model_PushBlock_ROM_END = pm3ds_null_segment);
PROVIDE(entity_model_PushBlock_ROM_START = pm3ds_null_segment);
PROVIDE(entity_model_RedBlock_ROM_END = pm3ds_null_segment);
PROVIDE(entity_model_RedBlock_ROM_START = pm3ds_null_segment);
PROVIDE(entity_model_RedSwitch_ROM_END = pm3ds_null_segment);
PROVIDE(entity_model_RedSwitch_ROM_START = pm3ds_null_segment);
PROVIDE(entity_model_SaveBlock_ROM_END = pm3ds_null_segment);
PROVIDE(entity_model_SaveBlock_ROM_START = pm3ds_null_segment);
PROVIDE(entity_model_ScriptSpring_anim_ROM_END = pm3ds_null_segment);
PROVIDE(entity_model_ScriptSpring_anim_ROM_START = pm3ds_null_segment);
PROVIDE(entity_model_ScriptSpring_gfx_ROM_END = pm3ds_null_segment);
PROVIDE(entity_model_ScriptSpring_gfx_ROM_START = pm3ds_null_segment);
PROVIDE(entity_model_ShatteringBrickBlock_ROM_END = pm3ds_null_segment);
PROVIDE(entity_model_ShatteringBrickBlock_ROM_START = pm3ds_null_segment);
PROVIDE(entity_model_ShatteringHammer1Block_ROM_END = pm3ds_null_segment);
PROVIDE(entity_model_ShatteringHammer1Block_ROM_START = pm3ds_null_segment);
PROVIDE(entity_model_ShatteringHammer2Block_ROM_END = pm3ds_null_segment);
PROVIDE(entity_model_ShatteringHammer2Block_ROM_START = pm3ds_null_segment);
PROVIDE(entity_model_ShatteringHammer3Block_ROM_END = pm3ds_null_segment);
PROVIDE(entity_model_ShatteringHammer3Block_ROM_START = pm3ds_null_segment);
PROVIDE(entity_model_Signpost_ROM_END = pm3ds_null_segment);
PROVIDE(entity_model_Signpost_ROM_START = pm3ds_null_segment);
PROVIDE(entity_model_SimpleSpring_anim_ROM_END = pm3ds_null_segment);
PROVIDE(entity_model_SimpleSpring_anim_ROM_START = pm3ds_null_segment);
PROVIDE(entity_model_SimpleSpring_gfx_ROM_END = pm3ds_null_segment);
PROVIDE(entity_model_SimpleSpring_gfx_ROM_START = pm3ds_null_segment);
PROVIDE(entity_model_SpinningFlower_ROM_END = pm3ds_null_segment);
PROVIDE(entity_model_SpinningFlower_ROM_START = pm3ds_null_segment);
PROVIDE(entity_model_StarBoxLauncher_ROM_END = pm3ds_null_segment);
PROVIDE(entity_model_StarBoxLauncher_ROM_START = pm3ds_null_segment);
PROVIDE(entity_model_SuperBlockContent_ROM_END = pm3ds_null_segment);
PROVIDE(entity_model_SuperBlockContent_ROM_START = pm3ds_null_segment);
PROVIDE(entity_model_SuperBlock_ROM_END = pm3ds_null_segment);
PROVIDE(entity_model_SuperBlock_ROM_START = pm3ds_null_segment);
PROVIDE(entity_model_TrumpetPlant_anim_ROM_END = pm3ds_null_segment);
PROVIDE(entity_model_TrumpetPlant_anim_ROM_START = pm3ds_null_segment);
PROVIDE(entity_model_TrumpetPlant_gfx_ROM_END = pm3ds_null_segment);
PROVIDE(entity_model_TrumpetPlant_gfx_ROM_START = pm3ds_null_segment);
PROVIDE(entity_model_Tweester_ROM_END = pm3ds_null_segment);
PROVIDE(entity_model_Tweester_ROM_START = pm3ds_null_segment);
PROVIDE(entity_model_UltraBlockContent_ROM_END = pm3ds_null_segment);
PROVIDE(entity_model_UltraBlockContent_ROM_START = pm3ds_null_segment);
PROVIDE(entity_model_UltraBlock_ROM_END = pm3ds_null_segment);
PROVIDE(entity_model_UltraBlock_ROM_START = pm3ds_null_segment);
PROVIDE(entity_model_WoodenCrate_ROM_END = pm3ds_null_segment);
PROVIDE(entity_model_WoodenCrate_ROM_START = pm3ds_null_segment);
PROVIDE(entity_model_YellowBlock_ROM_END = pm3ds_null_segment);
PROVIDE(entity_model_YellowBlock_ROM_START = pm3ds_null_segment);
PROVIDE(entity_sbk_omo_ROM_END = pm3ds_null_segment);
PROVIDE(entity_sbk_omo_ROM_START = pm3ds_null_segment);
PROVIDE(entity_sbk_omo_VRAM = pm3ds_null_segment);
PROVIDE(world_model_anim_kzn_00_VRAM = pm3ds_null_segment);
PROVIDE(world_model_anim_kzn_01_VRAM = pm3ds_null_segment);
PROVIDE(world_model_anim_kzn_02_VRAM = pm3ds_null_segment);
PROVIDE(world_model_anim_kzn_03_VRAM = pm3ds_null_segment);
PROVIDE(world_model_anim_kzn_04_VRAM = pm3ds_null_segment);
PROVIDE(world_model_anim_kzn_05_VRAM = pm3ds_null_segment);
PROVIDE(world_model_anim_kzn_06_VRAM = pm3ds_null_segment);
PROVIDE(world_model_anim_kzn_07_VRAM = pm3ds_null_segment);
PROVIDE(world_model_anim_kzn_08_VRAM = pm3ds_null_segment);
PROVIDE(world_model_anim_kzn_09_VRAM = pm3ds_null_segment);
PROVIDE(world_model_anim_kzn_0A_VRAM = pm3ds_null_segment);
PROVIDE(world_model_anim_kzn_0B_VRAM = pm3ds_null_segment);
PROVIDE(world_model_anim_kzn_0C_VRAM = pm3ds_null_segment);
PROVIDE(world_model_anim_kzn_0D_VRAM = pm3ds_null_segment);
PROVIDE(world_model_anim_kzn_0E_VRAM = pm3ds_null_segment);
PROVIDE(world_model_anim_kzn_0F_VRAM = pm3ds_null_segment);
PROVIDE(world_model_anim_kzn_10_VRAM = pm3ds_null_segment);
PROVIDE(world_model_anim_kzn_11_VRAM = pm3ds_null_segment);
PROVIDE(world_model_anim_kzn_12_VRAM = pm3ds_null_segment);
PROVIDE(world_model_anim_kzn_13_VRAM = pm3ds_null_segment);
PROVIDE(world_model_anim_kzn_14_VRAM = pm3ds_null_segment);
PROVIDE(world_model_anim_kzn_15_VRAM = pm3ds_null_segment);
PROVIDE(world_model_anim_kzn_16_VRAM = pm3ds_null_segment);
PROVIDE(world_model_anim_kzn_17_VRAM = pm3ds_null_segment);
PROVIDE(world_model_anim_kzn_18_VRAM = pm3ds_null_segment);
PROVIDE(world_model_anim_kzn_19_VRAM = pm3ds_null_segment);
PROVIDE(world_model_anim_kzn_1A_VRAM = pm3ds_null_segment);
PROVIDE(world_model_anim_kzn_1B_VRAM = pm3ds_null_segment);
PROVIDE(world_model_anim_kzn_1C_VRAM = pm3ds_null_segment);
PROVIDE(world_model_anim_kzn_1D_VRAM = pm3ds_null_segment);
PROVIDE(world_model_anim_kzn_1E_VRAM = pm3ds_null_segment);
PROVIDE(world_model_anim_kzn_1F_VRAM = pm3ds_null_segment);
PROVIDE(world_model_anim_kzn_20_VRAM = pm3ds_null_segment);
PROVIDE(world_model_anim_kzn_21_VRAM = pm3ds_null_segment);
PROVIDE(world_model_anim_kzn_22_VRAM = pm3ds_null_segment);
PROVIDE(world_model_anim_kzn_23_VRAM = pm3ds_null_segment);
PROVIDE(world_model_anim_kzn_24_VRAM = pm3ds_null_segment);
